## package/advancemame/Config.in
```kconfig
config BR2_PACKAGE_ADVANCEMAME
	bool "advancemame"
	select BR2_PACKAGE_RECALBOX_ROMFS_MAME
	help
	  A MAME 0.106-based emulator
	  http://www.advancemame.it
```

## package/dpi-pizero-gpicase/Config.in
```kconfig
config BR2_PACKAGE_DPI_PIZERO_GPICASE
	bool "dpi-pizero-gpicase"
	depends on BR2_PACKAGE_RPI_FIRMWARE
	help
	  dpi-pizero-gpicase overlay to get dpi 18 bits tft screen works
	  thanks to GPIOs GPIcase uses GPIO 18 and 19 for audio, so
	  theses GPIOs need to be avoid during the configuration
	  using the overlay.
```

## package/fbcp-ili9341/Config.in
```kconfig
config BR2_PACKAGE_FBCP_ILI9341
	bool "fbcp-ili9341"
	help
	  Raspberry Pi utility.
	  Used for mirror primary framebuffer to secondary framebuffer.

	  https://github.com/Cpasjuste/fbcp-ili9341
```

## package/freeplay-gpio-keys/Config.in
```kconfig
config BR2_PACKAGE_FREEPLAY_GPIO_KEYS
	bool "freeplay-gpio-keys"
	depends on BR2_PACKAGE_RPI_FIRMWARE
	help
	  Handle freeplay gpio keys
```

## package/freeplay-support/Config.in
```kconfig
config BR2_PACKAGE_FREEPLAY_SUPPORT
	bool "freeplay-support"
	depends on BR2_PACKAGE_RECALBOX_THEMES
	help
	  Support for the freeplay handheld

	  https://www.freeplaytech.com/
```

## package/gpsp/Config.in
```kconfig
config BR2_PACKAGE_GPSP
	bool "gpsp"
	depends on BR2_PACKAGE_SDL
	depends on BR2_PACKAGE_RPI_USERLAND
	help
	  A Gameboy Advance emulator.

comment "gpsp depends on SDL"
	depends on !BR2_PACKAGE_SDL || !BR2_PACKAGE_RPI_USERLAND
```

## package/guichan/Config.in
```kconfig
config BR2_PACKAGE_GUICHAN
	bool "guichan"
	depends on BR2_PACKAGE_SDL
	select BR2_PACKAGE_SDL_IMAGE
	help
	  A tiny GUI library

comment "Guichan depends on SDL"
	depends on !(BR2_PACKAGE_SDL)
```

## package/hyperion/Config.in
```kconfig
config BR2_PACKAGE_HYPERION
        bool "Hyperion"
	depends on BR2_INSTALL_LIBSTDCPP
	depends on BR2_PACKAGE_LIBUSB
	depends on BR2_PACKAGE_QT_GUI_MODULE
	depends on BR2_PACKAGE_QT_NETWORK
	depends on BR2_PACKAGE_QT
	depends on BR2_PACKAGE_QT_STL
	depends on BR2_PACKAGE_RPI_FIRMWARE
	depends on BR2_PACKAGE_RPI_USERLAND
	depends on BR2_PACKAGE_PROTOBUF
        help
          Hyperion is an open source ambient light software.
	  https://github.com/hyperion-project/hyperion

comment "Hyperion needs LIBUSB, QTCORE, QTNETWORK, QTGUI, PROTOBUF, and RPI_FIRMWARE"
	depends on !BR2_INSTALL_LIBSTDCPP || !BR2_PACKAGE_LIBUSB || !BR2_PACKAGE_QT_GUI_MODULE || \
		!BR2_PACKAGE_QT || !BR2_PACKAGE_QT_NETWORK || !BR2_PACKAGE_QT_STL || \
		!BR2_PACKAGE_RPI_FIRMWARE || !BR2_PACKAGE_RPI_USERLAND || !BR2_PACKAGE_PROTOBUF
```

## package/kernelfirmwares/Config.in
```kconfig
config BR2_PACKAGE_KERNELFIRMWARES
	bool "kernelfirmwares"
	help
	  This repository contains all these firmware images which
	  have been extracted from older drivers, as well various
	  new firmware images which we were never permitted to
	  include in a GPL'd work, but which we _have_ been
	  permitted to redistribute under separate cover.

	  https://git.kernel.org/?p=linux/kernel/git/firmware/linux-firmware.git
```

## package/kodi-resource-language-es_es/Config.in
```kconfig
config BR2_PACKAGE_KODI_RESOURCE_LANGUAGE_es_es
	bool "kodi-resource-language-es_es"
	default y
	depends on BR2_PACKAGE_KODI
	help
	  Kodi es_es language resource

	  https://kodi.tv
```

## package/kodi-resource-language-fr_fr/Config.in
```kconfig
config BR2_PACKAGE_KODI_RESOURCE_LANGUAGE_fr_fr
	bool "kodi-resource-language-fr_fr"
	default y
	depends on BR2_PACKAGE_KODI
	help
	  Kodi fr_fr language resource

	  https://kodi.tv
```

## package/kodi-resource-language-it_it/Config.in
```kconfig
config BR2_PACKAGE_KODI_RESOURCE_LANGUAGE_it_it
	bool "kodi-resource-language-it_it"
	default y
	depends on BR2_PACKAGE_KODI
	help
	  Kodi it_it language resource

	  https://kodi.tv
```

## package/kodi-resource-language-sv_se/Config.in
```kconfig
config BR2_PACKAGE_KODI_RESOURCE_LANGUAGE_sv_se
	bool "kodi-resource-language-sv_se"
	default y
	depends on BR2_PACKAGE_KODI
	help
	  Kodi sv_se language resource

	  https://kodi.tv
```

## package/kodi-resource-language-zh_cn/Config.in
```kconfig
config BR2_PACKAGE_KODI_RESOURCE_LANGUAGE_zh_cn
	bool "kodi-resource-language-zh_cn"
	default y
	depends on BR2_PACKAGE_KODI
	help
	  Kodi zh_cn language resource

	  https://kodi.tv
```

## package/libcross2d/Config.in
```kconfig
config BR2_PACKAGE_LIBCROSS2D
	bool "libcross2d"
	depends on BR2_PACKAGE_SDL2
	select BR2_PACKAGE_GLM
	select BR2_PACKAGE_LIBCONFIG
	select BR2_PACKAGE_FREETYPE
	select BR2_PACKAGE_ZLIB
	help
	  a c++ cross platform 2d graphic, input, audio and config library.

	  https://github.com/Cpasjuste/libcross2d

comment "libcross2d  needs a toolchain w/ C++,  SDL2"
	depends on !BR2_INSTALL_LIBSTDCPP || !BR2_PACKAGE_SDL2
```

## package/libretro-cap32/Config.in
```kconfig
config BR2_PACKAGE_LIBRETRO_CAP32
        bool "libretro-cap32"
	depends on BR2_PACKAGE_RETROARCH
	depends on BR2_INSTALL_LIBSTDCPP
	select BR2_PACKAGE_RECALBOX_ROMFS_AMSTRADCPC
	select BR2_PACKAGE_RECALBOX_ROMFS_GX4000
        help
          A libretro AMSTRAD CPC(+) emulator core.

	  http://www.libretro.com

comment "LIBRETRO_CAP32 needs a toolchain w/ C++"
	depends on !BR2_INSTALL_LIBSTDCPP
```

## package/libretro-flycast/Config.in
```kconfig
config BR2_PACKAGE_LIBRETRO_FLYCAST
	bool "libretro-flycast"
	depends on BR2_PACKAGE_RETROARCH
	depends on BR2_INSTALL_LIBSTDCPP
	select BR2_PACKAGE_RECALBOX_ROMFS_ATOMISWAVE
	select BR2_PACKAGE_RECALBOX_ROMFS_DREAMCAST
	select BR2_PACKAGE_RECALBOX_ROMFS_NAOMI
	help
	  A libretro atomiswave, dreamcast and naomi core.

	  http://www.libretro.com

comment "LIBRETRO_FLYCAST needs a toolchain w/ C++"
	depends on !BR2_INSTALL_LIBSTDCPP
```

## package/libretro-fmsx/Config.in
```kconfig
config BR2_PACKAGE_LIBRETRO_FMSX
	bool "libretro-fmsx"
	depends on BR2_PACKAGE_RETROARCH
	depends on BR2_INSTALL_LIBSTDCPP
	select BR2_PACKAGE_RECALBOX_ROMFS_MSX
	select BR2_PACKAGE_RECALBOX_ROMFS_MSX1
	select BR2_PACKAGE_RECALBOX_ROMFS_MSX2
	help
	  A libretro FMSX emulator core for ARM.

	  http://www.libretro.com

comment "LIBRETRO_FMSX needs a toolchain w/ C++"
	depends on !BR2_INSTALL_LIBSTDCPP
```

## package/libretro-gearsystem/Config.in
```kconfig
config BR2_PACKAGE_LIBRETRO_GEARSYSTEM
	bool "libretro-gearsystem"
	depends on BR2_PACKAGE_RETROARCH
	depends on BR2_INSTALL_LIBSTDCPP
	select BR2_PACKAGE_RECALBOX_ROMFS_GAMEGEAR
	select BR2_PACKAGE_RECALBOX_ROMFS_MASTERSYSTEM
	help
	  A libretro SEGA 8 bits emulator core for ARM.

	  http://www.libretro.com

comment "LIBRETRO_GEARSYSTEM needs a toolchain w/ C++"
	depends on !BR2_INSTALL_LIBSTDCPP
```

## package/libretro-kronos/Config.in
```kconfig
config BR2_PACKAGE_LIBRETRO_KRONOS
	bool "libretro-kronos"
	depends on BR2_PACKAGE_RETROARCH
	depends on BR2_INSTALL_LIBSTDCPP
	select BR2_PACKAGE_RECALBOX_ROMFS_SATURN
	help
	  A libretro Saturn emulator core.

	  http://www.libretro.com

comment "LIBRETRO_KRONOS needs a toolchain w/ C++"
	depends on !BR2_INSTALL_LIBSTDCPP
```

## package/libretro-pokemini/Config.in
```kconfig
config BR2_PACKAGE_LIBRETRO_POKEMINI
        bool "libretro-pokemini"
	depends on BR2_PACKAGE_RETROARCH
	depends on BR2_INSTALL_LIBSTDCPP
	select BR2_PACKAGE_RECALBOX_ROMFS_POKEMINI
        help
          A libretro Pokémon Mini emulator core.

	  http://www.libretro.com

comment "LIBRETRO_POKEMINI needs a toolchain w/ C++"
	depends on !BR2_INSTALL_LIBSTDCPP
```

## package/libretro-uzem/Config.in
```kconfig
config BR2_PACKAGE_LIBRETRO_UZEM
	bool "libretro-uzem"
	depends on BR2_PACKAGE_RETROARCH
	depends on BR2_INSTALL_LIBSTDCPP
	select BR2_PACKAGE_RECALBOX_ROMFS_UZEBOX
	help
	  A libretro Uzebox emulator core.

	  http://www.libretro.com

comment "LIBRETRO_UZEM needs a toolchain w/ C++"
	depends on !BR2_INSTALL_LIBSTDCPP
```

## package/libretro-yabasanshiro/Config.in
```kconfig
config BR2_PACKAGE_LIBRETRO_YABASANSHIRO
	bool "libretro-yabasanshiro"
	depends on BR2_PACKAGE_RETROARCH
	depends on BR2_INSTALL_LIBSTDCPP
	select BR2_PACKAGE_RECALBOX_ROMFS_SATURN
	help
	  A libretro Saturn emulator core.

	  http://www.libretro.com

comment "LIBRETRO_YABASANSHIRO needs a toolchain w/ C++"
	depends on !BR2_INSTALL_LIBSTDCPP
```

## package/libretro-yabause/Config.in
```kconfig
config BR2_PACKAGE_LIBRETRO_YABAUSE
	bool "libretro-yabause"
	depends on BR2_PACKAGE_RETROARCH
	depends on BR2_INSTALL_LIBSTDCPP
	select BR2_PACKAGE_RECALBOX_ROMFS_SATURN
	help
	  A libretro Saturn emulator core.

	  http://www.libretro.com

comment "LIBRETRO_YABAUSE needs a toolchain w/ C++"
	depends on !BR2_INSTALL_LIBSTDCPP
```
