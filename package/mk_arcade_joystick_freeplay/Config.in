## package/mk_arcade_joystick_freeplay/Config.in
```kconfig
config BR2_PACKAGE_MK_ARCADE_JOYSTICK_FREEPLAY
	bool "mk_arcade_joystick_freeplay"
	depends on BR2_LINUX_KERNEL
	help
	  Kernel module to support joystick on freeplay devices

comment "mk_arcade_joystick_freeplay needs a kernel and headers"
	depends on !BR2_LINUX_KERNEL
```

## package/pemu/Config.in
```kconfig
config BR2_PACKAGE_PEMU
	bool "pemu"
	depends on BR2_PACKAGE_SDL2
	select BR2_PACKAGE_GLM
	select BR2_PACKAGE_LIBCONFIG
	select BR2_PACKAGE_FREETYPE
	select BR2_PACKAGE_ZLIB
	help
	  pEMU: pFBA, pSNES, pNES emulators

	  https://github.com/Cpasjuste/pemu

comment "pemu needs a toolchain w/ C++,  SDL2"
	depends on !BR2_INSTALL_LIBSTDCPP || !BR2_PACKAGE_SDL2
```

## package/pisnes/Config.in
```kconfig
config BR2_PACKAGE_PISNES
	bool "pisnes"
	depends on BR2_INSTALL_LIBSTDCPP
	select BR2_PACKAGE_RECALBOX_ROMFS_SNES
	help
	  A SNES emulator core for ARM.

	  https://gitlab.com/Bkg2k/pisnes

comment "PCSX_REARMED needs a toolchain w/ C++"
	depends on !BR2_INSTALL_LIBSTDCPP
```

## package/qtsixa-shanwan/Config.in
```kconfig
config BR2_PACKAGE_QTSIXA_SHANWAN
	bool "qtsixashanwan"
	depends on BR2_PACKAGE_QTSIXA
	help
	  Support for ps3 controllers.

comment "qtsixashanwan depends on qtsixa"
	depends on !BR2_PACKAGE_QTSIXA
```

## package/recalbox-retrogame/Config.in
```kconfig
config BR2_PACKAGE_RECALBOX_RETROGAME
	bool "recalbox-retrogame"
	help
	  Recalbox-retrogame is optimized for Pi2
	  and manages a 2 player panel with an ESC key.

	  https://github.com/ian57/Recalbox-Retrogame-2Players-Pi2
```

## package/recalbox-romfs/recalbox-romfs-naomi/Config.in
```kconfig
config BR2_PACKAGE_RECALBOX_ROMFS_NAOMI
	bool "recalbox-romfs-naomi"
	select BR2_PACKAGE_RECALBOX_ROMS
	depends on BR2_PACKAGE_LIBRETRO_FLYCAST
	help
	  share_init/roms and xml for naomi
```

## package/recalbox-romfs/recalbox-romfs-palm/Config.in
```kconfig
config BR2_PACKAGE_RECALBOX_ROMFS_PALM
	bool "recalbox-romfs-palm"
	select BR2_PACKAGE_RECALBOX_ROMS
	depends on BR2_PACKAGE_LIBRETRO_MU
	help
	  share_init/roms and xml for palm
```

## package/recalbox-romfs/recalbox-romfs-pc88/Config.in
```kconfig
config BR2_PACKAGE_RECALBOX_ROMFS_PC88
	bool "recalbox-romfs-pc88"
	select BR2_PACKAGE_RECALBOX_ROMS
	depends on BR2_PACKAGE_LIBRETRO_QUASI88
	help
	  share_init/roms and xml for pc88
```

## package/recalbox-romfs/recalbox-romfs-pokemini/Config.in
```kconfig
config BR2_PACKAGE_RECALBOX_ROMFS_POKEMINI
	bool "recalbox-romfs-pokemini"
	select BR2_PACKAGE_RECALBOX_ROMS
	depends on BR2_PACKAGE_LIBRETRO_POKEMINI
	help
	  share_init/roms and xml for pokemini
```

## package/recalbox-romfs/recalbox-romfs-saturn/Config.in
```kconfig
config BR2_PACKAGE_RECALBOX_ROMFS_SATURN
	bool "recalbox-romfs-saturn"
	select BR2_PACKAGE_RECALBOX_ROMS
	depends on BR2_PACKAGE_LIBRETRO_BEETLE_SATURN \
	  || BR2_PACKAGE_LIBRETRO_KRONOS \
	  || BR2_PACKAGE_LIBRETRO_YABASANSHIRO \
	  || BR2_PACKAGE_LIBRETRO_YABAUSE
	help
	  share_init/roms and xml for saturn
```

## package/recalbox-romfs/recalbox-romfs-uzebox/Config.in
```kconfig
config BR2_PACKAGE_RECALBOX_ROMFS_UZEBOX
	bool "recalbox-romfs-uzebox"
	select BR2_PACKAGE_RECALBOX_ROMS
	depends on BR2_PACKAGE_LIBRETRO_UZEM
	help
	  share_init/roms and xml for uzebox
```

## package/recalbox-settings/Config.in
```kconfig
config BR2_PACKAGE_RECALBOX_SETTINGS
	bool "recalbox settings"
	depends on BR2_INSTALL_LIBSTDCPP
	help
	  A simple & fast settings manager.

	  https://github.com/recalbox/recalbox-settings
```

## package/rgbds/Config.in
```kconfig
config BR2_PACKAGE_RGBDS
	bool "rgbds"
	depends on BR2_INSTALL_LIBSTDCPP
	help
	  A z80 compiler

	  https://github.com/rednex/rgbds

comment "RGBDS needs a toolchain w/ C++"
	depends on !BR2_INSTALL_LIBSTDCPP
```
